#include "../project_cfg.h"
#ifdef  LED_MODULE
/******************************************************************************								
*  Name: .c
*  Description: 
*  Project: C_demo
*  Auther:  shanghai tianma
*              R&D center
*              penghu
*  MCU: S9KEAZ128AMLH
*  Comment:
******************************************************************************/		
#include "LED_data.h"
#include "LED_I2C.h"
#include "../../Headers/I2C.h"

/**********************************************************************************************
* External objects
**********************************************************************************************/


/**********************************************************************************************
* Global variables
**********************************************************************************************/

/**********************************************************************************************
* Constants and macros
**********************************************************************************************/
#define LED_I2C		I2C1

/**********************************************************************************************
* Local types
**********************************************************************************************/


/**********************************************************************************************
* Local function prototypes
*********************************************************************************************/

/**********************************************************************************************
* Local variables
**********************************************************************************************/


/**********************************************************************************************
* Local functions
**********************************************************************************************/


/**********************************************************************************************
* Global functions
**********************************************************************************************/
/***********************************************************************************************
*
* @brief    CTP_If_Init() - Program entry function
* @param    none
* @return   none
*
************************************************************************************************/
void LED_Data_Init(void)
{
	#define ADRESS_DATA_GROUP	0x1E
	#define ADRESS_DATA_SIZE	0x02
#if 0
    UINT8 address_send[28]={0x1A,0x1A,0x1A,0x60,0x61,0x62,0x63,0x64,0x65,0x66,
                            0x67,0x68,0x69,0x6A,0x6B,0x6C,0x6D,0x6E,0x6F,0x70,
                            0x71,0x72,0x73,0x74,0x75,0x76,0x77,0x78};
    UINT8 data_send[28]   ={0x08,0xBA,0xEF,0x0C,0xCC,0xDF,0xD0,0xDF,0x1D,0x70,
                            0x77,0x77,0x71,0x3B,0x00,0x0A,0x20,0xB0,0x84,0xC5,
                            0xF3,0xE5,0xE3,0x35,0x06,0xDF,0xFF,0x3E};
#endif
	UINT8 address_data_send[ADRESS_DATA_GROUP][ADRESS_DATA_SIZE]={
										{0x1A,0x08},{0x1A,0xBA},{0x1A,0xEF},{0x60,0x0C},{0x61,0xCC},
										{0x62,0xDF},{0x63,0xD0},{0x64,0xDF},{0x65,0x1D},{0x66,0x70},
										{0x67,0x77},{0x68,0x77},{0x69,0x71},{0x6A,0x3B},{0x6B,0x00},
										{0x6C,0x0A},{0x6D,0x20},{0x6E,0xB0},{0x6F,0x84},{0x70,0xC5},
										{0x71,0xF3},{0x72,0xE5},{0x73,0xE3},{0x74,0x35},{0x75,0x06},
										{0x76,0xDF},{0x77,0xFF},{0x78,0x3E},{0x19,0x02},{0x19,0x00}
										};
	

    //UINT8   read_data = 0;
    UINT8   number;
    
    LED_I2C_Init();

    for(number=0; number<ADRESS_DATA_GROUP; number++)
		I2C_MasterSendWait(LED_I2C, LED_SLAVE_ADDRESS_WRITE, &(address_data_send[number][0]), ADRESS_DATA_SIZE);
		
//        LED_I2C_Master_Write(&address_send[number], &data_send[number], 1);
#if 0
    for(number=3; number<28; number++)
    {
        LED_I2C_Master_Read(address_send[number], &read_data, 1);
        if(data_send[number] != read_data)
            break;
    }
#endif
    
//    LED_I2C_Master_Read(address_send[3], &read_data, 1);
}

#endif /* LED_MODULE */

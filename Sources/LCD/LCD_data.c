#include "../project_cfg.h"
#ifdef LCD_MODULE
/******************************************************************************								
*  Name: .c
*  Description: 
*  Project: C_demo
*  Auther:  shanghai tianma
*              R&D center
*              penghu
*  MCU: S9KEAZ128AMLH
*  Comment:
******************************************************************************/		
#include "LCD_data.h"
#include "LCD_spi.h"

/**********************************************************************************************
* External objects
**********************************************************************************************/


/**********************************************************************************************
* Global variables
**********************************************************************************************/

/**********************************************************************************************
* Constants and macros
**********************************************************************************************/

/**********************************************************************************************
* Local types
**********************************************************************************************/
typedef struct
{
    UINT8 reg_address;
    UINT8 reg_data;
}LCD_REG_SET;

/**********************************************************************************************
* Local function prototypes
*********************************************************************************************/

/**********************************************************************************************
* Local variables
**********************************************************************************************/


/**********************************************************************************************
* Local functions
**********************************************************************************************/


/**********************************************************************************************
* Global functions
**********************************************************************************************/
/***********************************************************************************************
*
* @brief    CTP_If_Init() - Program entry function
* @param    none
* @return   none
*
************************************************************************************************/
void LCD_Data_Init(void)
{
#if 0
	LCD_REG_SET reg_set[] ={
 		    {0x00,0x00},{0x02,0xB1},{0x03,0x32},{0x06,0x13},{0x07,0x10},  /* 1-5 */
        {0x18,0xA3},{0x19,0x20},{0x00,0x01},{0x04,0x72},{0x12,0xF9},  /* 6-10 */
        {0x13,0x1A},{0x14,0x00},{0x17,0x1d},{0x00,0x02},{0x01,0x00},  /* 11-15 */
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        {0x1F,0x00}};/* 186 */ 
#endif	
LCD_REG_SET reg_set[] ={
{0x00,0x00},//master
{0x02,0x33},
{0x03,0xFA},
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{0x57,0xeb}
		};/*total 251*/      
    UINT32 reg_set_size = sizeof(reg_set)/sizeof(LCD_REG_SET);
    UINT32 i;
    //UINT8 data=0;

    LCD_Spi_Init();
	LCD_Spi_GPIO_Init_Standby();
    // write data
	for(i=0; i<10000; i++)
    {
		;
    }
	
    for(i=0; i<reg_set_size; i++)
    {
       LCD_Spi_Write_Register(reg_set[i].reg_address, reg_set[i].reg_data);
    }
#if 0
    // read data and check register data
    for(i=0; i<reg_set_size; i++)
    {
        if(reg_set[i].reg_address != LCD_IC_PAGE_REG)
        {
            LCD_Spi_Read_Register(LCD_SID_MASTER, reg_set[i].reg_address, &data);
            if(data != reg_set[i].reg_data)
                break;
        }
        else
            LCD_Spi_Write_Page(LCD_SID_MASTER, reg_set[i].reg_data);
    }
#endif
    
}


#endif /* LCD_MODULE */

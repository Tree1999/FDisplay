#ifdef  CTP_MODULE
/******************************************************************************								
*  Name: .c
*  Description: 
*  Project: C_demo
*  Auther:  shanghai tianma
*              R&D center
*              penghu
*  MCU: S9KEAZ128AMLH
*  Comment:
******************************************************************************/		
#include "CTP_ctrl.h"
#include "CTP_data.h"
#include "atmel_1189.h"

/**********************************************************************************************
* External objects
**********************************************************************************************/

/**********************************************************************************************
* Global variables
**********************************************************************************************/
static UINT8 Touch_Int = false;

/**********************************************************************************************
* Constants and macros
**********************************************************************************************/


/**********************************************************************************************
* Local types
**********************************************************************************************/
static UINT8 chip_detected_flag = false;


/**********************************************************************************************
* Local function prototypes
*********************************************************************************************/

/**********************************************************************************************
* Local variables
**********************************************************************************************/


/**********************************************************************************************
* Local functions
**********************************************************************************************/


/**********************************************************************************************
* Global functions
**********************************************************************************************/
/***********************************************************************************************
*
* @brief    CTP_If_Init() - Program entry function
* @param    none
* @return   none
*
************************************************************************************************/
void CTP_Ctrl_Init(void)
{
#if 1
//    UINT32 number=0;
    CTP_Data_Init();
//    while(number++ < 0x00FFFFFF);
    CTP_Data_Write();
//    CTP_Data_Read();
#endif
}

/***********************************************************************************************
*
* @brief    CTP_If_Init() - Program entry function
* @param    none
* @return   none
*
************************************************************************************************/
void CTP_Ctrl_Touch_Coordinate_Get(void)
{
    
}

/***********************************************************************************************
*
* @brief    CTP_If_Init() - Program entry function
* @param    none
* @return   none
*
************************************************************************************************/
void CTP_Ctrl_Touch_Interrupt_Notice(void)
{
    if(chip_detected_flag == true)
        Touch_Int = true;
}

/***********************************************************************************************
*
* @brief    CTP_If_Init() - Program entry function
* @param    none
* @return   none
*
************************************************************************************************/
void CTP_Ctrl_Touch_Interrupt_Clear(void)
{
    Touch_Int = false;
}

/***********************************************************************************************
*
* @brief    CTP_If_Init() - Program entry function
* @param    none
* @return   none
*
************************************************************************************************/
void CTP_Ctrl_Task(void)
{
    chip_detected_flag = init_touch_app();  // find and initialise QT device 
    if(chip_detected_flag == true)
    {
        for(;;)  // loop forever... 
        {
    // penghu      asm("nop"); 
    // penghu      asm("nop"); 
    // penghu      asm("nop"); 
    //------- 用查询CHG 的方式读取信号 --------------------      
            if(chip_detected_flag == true)
            {  
    // THIERRY            if(ChangeLineStatus() == CHANGELINE_ASSERTED)
    			if(Touch_Int == true)
                {
                    get_message();
                    CTP_Ctrl_Touch_Interrupt_Clear();
                }  
            }  
        }
    }
}

#endif /* CTP_MODULE */
